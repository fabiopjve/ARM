// As duas linhas abaixo definem a área de memória de programa
-DROMSTART=0x40000000
-DROMEND=0x4003FFFF

// área de memória de dados
-DRAMSTART=0x20000000
-DRAMEND=0x2000FFFF

// para que o programa seja armazenado na RAM, retire os comentários abaixo
//-DROMSTART=RAMSTART
//-DROMEND=RAMEND

-carm

//**************************************************************************
// Address range for reset and exception vectors (INTVEC).
//**************************************************************************
-Z(CODE)INTVEC=ROMSTART-ROMEND

//**************************************************************************
// Startup code and exception routines (ICODE).
//**************************************************************************
-Z(CODE)ICODE,DIFUNCT=ROMSTART-ROMEND
-Z(CODE)SWITAB=ROMSTART-ROMEND

//**************************************************************************
// Code segments may be placed anywhere.
//**************************************************************************

-Z(CODE)CODE=ROMSTART-ROMEND

//**************************************************************************
// Original ROM location for __ramfunc code copied to and executed from RAM.
//**************************************************************************
-Z(CONST)CODE_ID=ROMSTART-ROMEND

//**************************************************************************
// Various constants and initializers.
//**************************************************************************
-Z(CONST)INITTAB,DATA_ID,DATA_C=ROMSTART-ROMEND
-Z(CONST)CHECKSUM=ROMSTART-ROMEND

//**************************************************************************
// Data segments.
//**************************************************************************
-Z(DATA)DATA_I,DATA_Z,DATA_N=RAMSTART-RAMEND
//**************************************************************************
// __ramfunc code copied to and executed from RAM.
//**************************************************************************
-Z(DATA)CODE_I=RAMSTART-RAMEND

//**************************************************************************
// ICCARM produces code for __ramfunc functions in CODE_I segments. The -Q 
// XLINK command line option redirects XLINK to emit the code in the CODE_ID
// segment instead, but to keep symbol and debug information associated with 
// the CODE_I segment, where the code will execute.
//**************************************************************************
-QCODE_I=CODE_ID

//**************************************************************************
// Stack and heap segments.
//**************************************************************************

-D_CSTACK_SIZE=400
-D_SVC_STACK_SIZE=100
-D_FIQ_STACK_SIZE=100
-D_ABT_STACK_SIZE=100
-D_UNDEF_STACK_SIZE=100
-D_IRQ_STACK_SIZE=100
-D_HEAP_SIZE=400

-Z(DATA)CSTACK+_CSTACK_SIZE=RAMSTART-RAMEND
-Z(DATA)SVC_STACK+_SVC_STACK_SIZE=RAMSTART-RAMEND
-Z(DATA)ABT_STACK+_ABT_STACK_SIZE=RAMSTART-RAMEND
-Z(DATA)UNDEF_STACK+_UNDEF_STACK_SIZE=RAMSTART-RAMEND
-Z(DATA)FIQ_STACK+_FIQ_STACK_SIZE=RAMSTART-RAMEND
-Z(DATA)IRQ_STACK+_IRQ_STACK_SIZE=RAMSTART-RAMEND
-Z(DATA)HEAP+_HEAP_SIZE=RAMSTART-RAMEND

